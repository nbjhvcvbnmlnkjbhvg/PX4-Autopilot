## boards/airvolute/dcs2-pilot/nuttx-config/canbootloader/defconfig
```kconfig
#
# DCS2.Pilot STM32H743 CAN bootloader NuttX configuration
#
CONFIG_ARCH="arm"
CONFIG_ARCH_BOARD_CUSTOM=y
CONFIG_ARCH_BOARD_CUSTOM_DIR="../../../../boards/airvolute/dcs2-pilot/nuttx-config"
CONFIG_ARCH_BOARD_CUSTOM_DIR_RELPATH=y
CONFIG_ARCH_BOARD_CUSTOM_NAME="px4"
CONFIG_ARCH_CHIP="stm32h7"
CONFIG_ARCH_CHIP_STM32H743II=y
CONFIG_ARCH_CHIP_STM32H7=y
CONFIG_ARCH_INTERRUPTSTACK=512
CONFIG_ARMV7M_DCACHE=y
CONFIG_ARMV7M_ICACHE=y
CONFIG_ARMV7M_USEBASEPRI=y
CONFIG_BOARD_LOOPSPERMSEC=95150
CONFIG_BOARD_RESET_ON_ASSERT=2
CONFIG_BUILTIN=y
CONFIG_DEBUG_FULLOPT=y
CONFIG_DEBUG_SYMBOLS=y
CONFIG_DEFAULT_SMALL=y
CONFIG_HAVE_CXX=y
CONFIG_HAVE_CXXINITIALIZE=y
CONFIG_IDLETHREAD_STACKSIZE=4096
CONFIG_INIT_ENTRYPOINT="canbootloader_main"
CONFIG_INIT_STACKSIZE=4096
CONFIG_MM_REGIONS=4
CONFIG_RAW_BINARY=y
CONFIG_RAM_SIZE=524288
CONFIG_RAM_START=0x20010000
CONFIG_STM32H7_FDCAN1=y
CONFIG_USEC_PER_TICK=1000
```
